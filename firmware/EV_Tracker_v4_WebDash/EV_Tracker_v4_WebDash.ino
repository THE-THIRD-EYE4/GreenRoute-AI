/*
  =====================================================================
  EV VEHICLE TRACKER - Prototype Firmware v4.0  (Local Wi-Fi Web Dashboard)
  GPS Tracking | Engine ON/OFF | Battery Removal Alarm | Immobiliser | SMS
  MCU     : ESP32 DevKit V1 (Board: "ESP32 Dev Module")
  Network : 2.4 GHz Wi-Fi (router / phone hotspot) + backup soft-AP "EV-Tracker"
  Alerts  : Live web dashboard (http://<IP> or http://evtracker.local)
            + SMS to the owner through the SIM800L (optional)
  No cloud and no Firebase in this version.
  =====================================================================

  PIN MAP (matches schematic EVT-SCH-03 - frozen)
    GPS  UART2   : GPIO16 (RX2) <- GPS TX,  GPIO17 (TX2) -> GPS RX
    SIM800L UART1: GPIO26 (RX1) <- SIM TXD, GPIO27 (TX1) -> 1k/3k3 divider -> SIM RXD
    SIM800L RST  : GPIO4  (open-drain: driven LOW to reset, otherwise input)
    Relay        : GPIO25
    Engine sense : GPIO34 (input only, EXTERNAL 10k pull-up to 3.3V)
    I2C INA226   : GPIO21 SDA, GPIO22 SCL  (INA226 powered from 3.3V)
    Buzzer       : GPIO13 -> 1k -> BC547 base
    Status LED   : GPIO2  (solid = Wi-Fi connected, blinking = not connected)

  LIBRARIES (Arduino Library Manager)
    1. TinyGPSPlus   by Mikal Hart
    2. TinyGSM       by Volodymyr Shymanskyy   (only when USE_SIM800L is true)
    3. INA226        by Rob Tillaart (v0.5.x or newer)
    Built in to the ESP32 core: WiFi, WebServer, ESPmDNS, Preferences, Wire
    Board package: esp32 by Espressif Systems 2.0.x (2.0.17 tested setup) or 3.x

  WEB PAGE
    The dashboard lives in web/index.html. After editing it run
        python tools/embed.py
    which regenerates web_index.h in this folder (gzip-compressed).
=====================================================================
*/

// =====================================================================
// USER CONFIG  -- edit these before uploading
// =====================================================================
// The ESP32 radio is 2.4 GHz only: it cannot join a 5 GHz network.
// On a dual-band router use the 2.4 GHz SSID (or enable a 2.4 GHz band).
#define WIFI_SSID            "YOUR_WIFI_SSID"
#define WIFI_PASSWORD        "YOUR_WIFI_PASSWORD"

// Backup hotspot, always on: join it and open http://192.168.4.1
#define AP_SSID              "EV-Tracker"
#define AP_PASSWORD          "evtracker123"      // min 8 characters
#define MDNS_NAME            "evtracker"         // -> http://evtracker.local

#define VEHICLE_ID           "EV_TRACKER_01"
#define CONTROL_PIN          "1234"              // needed for every control command

// SIM800L: true = fitted (SMS alerts), false = build and run without a modem
#define USE_SIM800L          true
#define OWNER_PHONE          "+91XXXXXXXXXX"     // SMS alerts go here
#define SMS_ENABLED          true
#define SIM_PIN              ""                  // leave empty: disable PIN in a phone

// Engine sense: 0 = Hall sensor pulses (AH3144), 1 = ignition sense via PC817 (LOW = ON)
#define ENGINE_SENSE_MODE    0

// Most blue 1-ch relay modules are ACTIVE LOW. Confirm with bench test T11.
#define RELAY_ACTIVE_LOW     true

// Battery thresholds (volts at INA226 VBUS). Defaults: 12 V bench test.
const float BATT_DIVIDER_RATIO   = 1.0;
const float BATT_PRESENT_MIN_V   = 6.0;
const float BATT_EMPTY_V         = 10.5;
const float BATT_FULL_V          = 12.7;

const float INA_SHUNT_OHM        = 0.1;
const float INA_MAX_CURRENT_A    = 0.8;

const float IMMOBILISE_MAX_KMPH  = 5.0;

#define SIM_BAUD             57600               // drop to 9600 if AT replies are garbled

// =====================================================================
// PIN MAP (do not change without updating the schematic)
// =====================================================================
#define PIN_GPS_RX       16
#define PIN_GPS_TX       17
#define PIN_SIM_RX       26
#define PIN_SIM_TX       27
#define PIN_SIM_RST      4
#define PIN_RELAY        25
#define PIN_ENGINE       34
#define PIN_SDA          21
#define PIN_SCL          22
#define PIN_BUZZER       13
#define PIN_LED          2

#define FW_VERSION       "4.0"

// ---------------- TinyGSM must be configured before its include ----------------
#if USE_SIM800L
  #define TINY_GSM_MODEM_SIM800
  #define TINY_GSM_RX_BUFFER 1024
  #include <TinyGsmClient.h>
#endif

#include <WiFi.h>
#include <WebServer.h>
#include <ESPmDNS.h>
#include <Preferences.h>
#include <Wire.h>
#include <time.h>
#include <TinyGPSPlus.h>
#include <INA226.h>

#include "web_index.h"     // generated by tools/embed.py from web/index.html

// =====================================================================
// TIMING
// =====================================================================
const unsigned long BATTERY_CHECK_MS     = 100;
const unsigned long STATUS_PRINT_MS      = 2000;
const unsigned long ENGINE_TIMEOUT_MS    = 2000;
const unsigned long WIFI_RETRY_MS        = 10000;
const unsigned long MODEM_CHECK_MS       = 30000;
const unsigned long MODEM_REG_CHECK_MS   = 10000;   // while not yet registered
const unsigned long SMS_MIN_GAP_MS       = 300000;  // max one alert SMS per 5 min
const unsigned long SMS_RETRY_MS         = 30000;   // gap between failed SMS attempts
const unsigned long RESTORE_GRACE_MS     = 10000;   // let GPS report speed before re-cutting
const uint8_t       BATT_DEBOUNCE_COUNT  = 3;
const uint8_t       MAX_ALERTS           = 20;

// =====================================================================
// OBJECTS
// =====================================================================
TinyGPSPlus     gps;
HardwareSerial  GPSSerial(2);
INA226          ina(0x40);
WebServer       server(80);
Preferences     prefs;

#if USE_SIM800L
HardwareSerial  SerialAT(1);
TinyGsm         modem(SerialAT);
#endif

// =====================================================================
// STATE
// =====================================================================
volatile uint32_t hallPulseCount = 0;
volatile unsigned long lastPulseMs = 0;

bool  inaOk = false, modemOk = false, netRegistered = false;
bool  engineOn = false, batteryPresent = true, alarmActive = false;
bool  immobilised = false, immobilisePending = false;
bool  pendingSms = false, pendingRestoreSms = false;
bool  restoreCutAtBoot = false;
bool  staWasConnected = false;
float battVoltage = 0, battCurrent_mA = 0, pulsesPerSec = 0;
int   csq = 99;
String gsmOperator = "";
uint8_t battLowCount = 0, battOkCount = 0;
uint32_t bootCount = 0;
long  utcBase = 0;          // UTC epoch at millis()==0, learned from GPS (0 = unknown)

unsigned long lastBattCheck = 0, lastPrint = 0, lastWifiTry = 0;
unsigned long lastModemCheck = 0, lastSmsMs = 0, lastSmsTry = 0, beepUntil = 0;
unsigned long lastRateCalc = 0; uint32_t lastPulseSnapshot = 0;

// ---------------- Alert log (newest first, kept in NVS) ----------------
enum AlertType : uint8_t {
  A_BATTERY_REMOVED = 0, A_BATTERY_RESTORED, A_IGNITION_CUT, A_IGNITION_ALLOWED,
  A_CUT_QUEUED, A_ALARM_CLEARED, A_TRACKER_STARTED
};
const char* const ALERT_NAMES[] = {
  "BATTERY_REMOVED", "BATTERY_RESTORED", "IGNITION_CUT", "IGNITION_ALLOWED",
  "CUT_QUEUED", "ALARM_CLEARED", "TRACKER_STARTED"
};

struct Alert {
  uint32_t up;       // uptime seconds when it happened
  uint32_t boot;     // boot counter (uptime only meaningful within one boot)
  uint32_t epoch;    // UTC epoch from GPS, 0 if unknown
  uint8_t  type;
  uint8_t  hasLoc;
  float    v;
  double   lat, lng;
};
Alert   alerts[MAX_ALERTS];
uint8_t alertCount = 0;

struct CmdResult { bool ok; String msg; };

// Forward declarations (keeps the Arduino prototype generator out of trouble)
CmdResult applyCommand(String cmd);
void logAlert(AlertType type);
bool sendSms(const String& text);
void startWiFi();
void maintainWiFi();
void printUrls();
void startWebServer();
void startModem();
void maintainModem();
void sendPendingSms();
void updateEngine();
void updateBattery();
void handleImmobilisePending();
void printHelp();
void printStatus();
void handleSerialMenu();

// =====================================================================
// ISR + HELPERS
// =====================================================================
void IRAM_ATTR onHallPulse() { hallPulseCount++; lastPulseMs = millis(); }

void setRelay(bool energise) {
  bool level = RELAY_ACTIVE_LOW ? !energise : energise;
  digitalWrite(PIN_RELAY, level ? HIGH : LOW);
  immobilised = energise;              // energised => NC opens => ignition cut
}

void setBuzzer(bool on) { digitalWrite(PIN_BUZZER, on ? HIGH : LOW); }

float gpsSpeed() {
  return (gps.speed.isValid() && gps.speed.age() < 3000) ? gps.speed.kmph() : 0.0;
}

bool gpsFix() { return gps.location.isValid() && gps.location.age() < 5000; }

// Feed GPS while waiting on slow operations
void serviceGPS() { while (GPSSerial.available()) gps.encode(GPSSerial.read()); }

String mapsLink() {
  if (!gps.location.isValid()) return "GPS no fix";
  return "https://maps.google.com/?q=" + String(gps.location.lat(), 6) + "," + String(gps.location.lng(), 6);
}

int batteryPercent() {
  float p = (battVoltage - BATT_EMPTY_V) * 100.0 / (BATT_FULL_V - BATT_EMPTY_V);
  return constrain((int)p, 0, 100);
}

uint32_t uptimeS() { return millis() / 1000; }

// Days since 1970-01-01 for a civil date (Howard Hinnant's algorithm)
long daysFromCivil(int y, unsigned m, unsigned d) {
  y -= m <= 2;
  const long era = (y >= 0 ? y : y - 399) / 400;
  const unsigned yoe = (unsigned)(y - era * 400);
  const unsigned doy = (153 * (m + (m > 2 ? -3 : 9)) + 2) / 5 + d - 1;
  const unsigned doe = yoe * 365 + yoe / 4 - yoe / 100 + doy;
  return era * 146097 + (long)doe - 719468;
}

// Learn UTC from GPS once it is valid; keep it running from millis() afterwards
void updateClock() {
  if (!gps.date.isValid() || !gps.time.isValid() || gps.date.year() < 2024) return;
  if (gps.time.age() > 1500) return;
  long epoch = daysFromCivil(gps.date.year(), gps.date.month(), gps.date.day()) * 86400L
             + gps.time.hour() * 3600L + gps.time.minute() * 60L + gps.time.second();
  utcBase = epoch - (long)uptimeS();
}

uint32_t utcNow() { return utcBase ? (uint32_t)(utcBase + (long)uptimeS()) : 0; }

String isoUtc(uint32_t epoch) {
  if (!epoch) return "";
  time_t t = epoch; struct tm tmv; gmtime_r(&t, &tmv);
  char buf[24]; strftime(buf, sizeof(buf), "%Y-%m-%dT%H:%M:%SZ", &tmv);
  return String(buf);
}

String jsonEscape(const String& s) {
  String o; o.reserve(s.length() + 4);
  for (size_t i = 0; i < s.length(); i++) {
    char c = s[i];
    if (c == '"' || c == '\\') { o += '\\'; o += c; }
    else if ((uint8_t)c < 0x20) o += ' ';
    else o += c;
  }
  return o;
}

// =====================================================================
// PERSISTENCE (NVS)
// =====================================================================
void saveAlerts() {
  prefs.putUChar("acount", alertCount);
  prefs.putBytes("alerts", alerts, sizeof(Alert) * alertCount);
}

void loadAlerts() {
  alertCount = prefs.getUChar("acount", 0);
  if (alertCount > MAX_ALERTS) alertCount = 0;
  size_t want = sizeof(Alert) * alertCount;
  if (alertCount && prefs.getBytesLength("alerts") == want) prefs.getBytes("alerts", alerts, want);
  else alertCount = 0;
}

void saveRelayState() { prefs.putBool("cut", immobilised || immobilisePending); }

void logAlert(AlertType type) {
  if (alertCount < MAX_ALERTS) alertCount++;
  for (int i = alertCount - 1; i > 0; i--) alerts[i] = alerts[i - 1];   // newest first
  Alert& a = alerts[0];
  a.up = uptimeS(); a.boot = bootCount; a.epoch = utcNow(); a.type = type;
  a.v = battVoltage;
  a.hasLoc = gps.location.isValid();
  a.lat = a.hasLoc ? gps.location.lat() : 0;
  a.lng = a.hasLoc ? gps.location.lng() : 0;
  saveAlerts();
  Serial.printf("[ALERT] %s\n", ALERT_NAMES[type]);
}

// =====================================================================
// COMMANDS (shared by the web API and the serial menu)
// =====================================================================
CmdResult applyCommand(String cmd) {
  cmd.trim(); cmd.toUpperCase();
  Serial.printf(">> Command: %s\n", cmd.c_str());

  if (cmd == "OFF") {
    if (immobilised) return {true, "Ignition is already cut"};
    float spd = gpsSpeed();
    if (spd > IMMOBILISE_MAX_KMPH) {
      if (!immobilisePending) { immobilisePending = true; saveRelayState(); logAlert(A_CUT_QUEUED); }
      return {true, "Vehicle moving at " + String(spd, 0) + " km/h: cut queued until it stops"};
    }
    immobilisePending = false;
    setRelay(true); saveRelayState(); logAlert(A_IGNITION_CUT);
    return {true, "Ignition cut"};
  }
  if (cmd == "ON") {
    bool changed = immobilised || immobilisePending;
    immobilisePending = false; restoreCutAtBoot = false;
    setRelay(false); saveRelayState();
    if (changed) logAlert(A_IGNITION_ALLOWED);
    return {true, changed ? "Engine allowed" : "Engine was already allowed"};
  }
  if (cmd == "CLEAR") {
    bool was = alarmActive;
    alarmActive = false; beepUntil = 0; setBuzzer(false);
    if (was) logAlert(A_ALARM_CLEARED);
    return {true, was ? "Alarm silenced" : "No alarm to silence"};
  }
  if (cmd == "BEEP") {
    beepUntil = millis() + 1000; setBuzzer(true);    // non-blocking, ended in loop()
    return {true, "Buzzer test: 1 second beep"};
  }
  if (cmd == "SMS") {
#if USE_SIM800L
    if (!SMS_ENABLED)   return {false, "SMS is turned off in the firmware config"};
    if (!modemOk)       return {false, "SIM800L is not ready - check power and wiring"};
    if (!netRegistered) return {false, "SIM800L has no 2G network yet - check SIM and antenna"};
    bool ok = sendSms("EV TRACKER test SMS. " + mapsLink());
    String msg = ok ? String("Test SMS sent to " OWNER_PHONE)
                    : String("SMS failed - check SIM balance and signal");
    return {ok, msg};
#else
    return {false, "SIM800L is not fitted in this build"};
#endif
  }
  return {false, "Unknown command"};
}

void handleImmobilisePending() {
  if (restoreCutAtBoot && millis() >= RESTORE_GRACE_MS) {
    restoreCutAtBoot = false;
    immobilisePending = true;
    Serial.println(F("Re-applying ignition cut remembered from before the reboot"));
  }
  if (immobilisePending && gpsSpeed() <= IMMOBILISE_MAX_KMPH) {
    immobilisePending = false; setRelay(true); saveRelayState(); logAlert(A_IGNITION_CUT);
    Serial.println(F("   Speed low - immobiliser engaged"));
  }
}

// =====================================================================
// SETUP
// =====================================================================
void setup() {
  pinMode(PIN_RELAY, OUTPUT);  setRelay(false);   // RUN first: never cut during boot
  pinMode(PIN_BUZZER, OUTPUT); setBuzzer(false);
  pinMode(PIN_LED, OUTPUT);
  pinMode(PIN_SIM_RST, INPUT);

  Serial.begin(115200);
  delay(300);
  Serial.println(F("\n=== EV Tracker v" FW_VERSION " (local web dashboard) ==="));

  prefs.begin("evtracker", false);
  bootCount = prefs.getUInt("boot", 0) + 1;
  prefs.putUInt("boot", bootCount);
  loadAlerts();
  restoreCutAtBoot = prefs.getBool("cut", false);
  if (restoreCutAtBoot) Serial.println(F("[..] Vehicle was immobilised before reboot - will re-cut after GPS check"));

  GPSSerial.setRxBufferSize(2048);
  GPSSerial.begin(9600, SERIAL_8N1, PIN_GPS_RX, PIN_GPS_TX);

  pinMode(PIN_ENGINE, INPUT);
#if ENGINE_SENSE_MODE == 0
  attachInterrupt(digitalPinToInterrupt(PIN_ENGINE), onHallPulse, FALLING);
#endif

  Wire.begin(PIN_SDA, PIN_SCL);
  inaOk = ina.begin();
  if (inaOk) {
    ina.setMaxCurrentShunt(INA_MAX_CURRENT_A, INA_SHUNT_OHM);
    ina.setAverage(INA226_16_SAMPLES);
    Serial.println(F("[OK] INA226 found at 0x40"));
  } else {
    Serial.println(F("[ERR] INA226 not found - check SDA/SCL/3V3"));
  }

  startWiFi();
  startWebServer();
  logAlert(A_TRACKER_STARTED);

#if USE_SIM800L
  startModem();
#endif
  printHelp();
  printUrls();
}

// =====================================================================
// LOOP
// =====================================================================
void loop() {
  server.handleClient();
  serviceGPS();
  updateClock();
  updateEngine();

  if (millis() - lastBattCheck >= BATTERY_CHECK_MS) { lastBattCheck = millis(); updateBattery(); }
  if (beepUntil && (long)(millis() - beepUntil) >= 0) { beepUntil = 0; setBuzzer(alarmActive); }

  maintainWiFi();
#if USE_SIM800L
  maintainModem();
  sendPendingSms();
#endif
  handleImmobilisePending();

  if (millis() - lastPrint >= STATUS_PRINT_MS) { lastPrint = millis(); printStatus(); }
  handleSerialMenu();

  bool sta = WiFi.status() == WL_CONNECTED;
  digitalWrite(PIN_LED, sta ? HIGH : (millis() / 250) % 2);
}

// =====================================================================
// WI-FI (STA to your 2.4 GHz router + always-on backup AP)
// =====================================================================
void startWiFi() {
  WiFi.mode(WIFI_AP_STA);
  WiFi.setSleep(false);                      // faster page responses
  WiFi.softAP(AP_SSID, AP_PASSWORD);
  Serial.printf("[OK] Backup hotspot \"%s\" up at http://%s\n", AP_SSID, WiFi.softAPIP().toString().c_str());
  WiFi.begin(WIFI_SSID, WIFI_PASSWORD);
  Serial.printf("[..] Joining Wi-Fi \"%s\" (2.4 GHz)", WIFI_SSID);
  for (int i = 0; i < 20 && WiFi.status() != WL_CONNECTED; i++) { delay(500); Serial.print('.'); }
  Serial.println();
  lastWifiTry = millis();
  MDNS.begin(MDNS_NAME);
  MDNS.addService("http", "tcp", 80);
}

void maintainWiFi() {
  bool sta = WiFi.status() == WL_CONNECTED;
  if (sta && !staWasConnected) {             // just connected (or reconnected)
    MDNS.end(); MDNS.begin(MDNS_NAME); MDNS.addService("http", "tcp", 80);
    printUrls();
  }
  if (!sta && staWasConnected) Serial.println(F("[WARN] Wi-Fi dropped - retrying every 10 s (hotspot still on)"));
  staWasConnected = sta;

  if (!sta && millis() - lastWifiTry > WIFI_RETRY_MS) {
    lastWifiTry = millis();
    WiFi.begin(WIFI_SSID, WIFI_PASSWORD);
  }
}

void printUrls() {
  Serial.println(F("------------------------------------------------------------"));
  if (WiFi.status() == WL_CONNECTED) {
    Serial.printf(" Open http://%s (or http://%s.local) on a phone/laptop on the same Wi-Fi\n",
                  WiFi.localIP().toString().c_str(), MDNS_NAME);
  } else {
    Serial.printf(" Wi-Fi \"%s\" not connected yet (must be 2.4 GHz).\n", WIFI_SSID);
  }
  Serial.printf(" Or join hotspot \"%s\" (password %s) and open http://%s\n",
                AP_SSID, AP_PASSWORD, WiFi.softAPIP().toString().c_str());
  Serial.println(F("------------------------------------------------------------"));
}

// =====================================================================
// WEB SERVER + API
// =====================================================================
void addCors() {
  server.sendHeader("Access-Control-Allow-Origin", "*");
  server.sendHeader("Access-Control-Allow-Methods", "GET, POST, OPTIONS");
  server.sendHeader("Access-Control-Allow-Headers", "Content-Type");
  server.sendHeader("Access-Control-Allow-Private-Network", "true");
}

void sendJson(int code, const String& body) {
  addCors();
  server.sendHeader("Cache-Control", "no-store");
  server.send(code, "application/json", body);
}

void handleOptions() { addCors(); server.send(204); }

void handleRoot() {
  server.sendHeader("Cache-Control", "no-cache");
#if WEB_INDEX_GZIP
  server.sendHeader("Content-Encoding", "gzip");
#endif
  server.send_P(200, "text/html; charset=utf-8", (const char*)WEB_INDEX, WEB_INDEX_LEN);
}

void handleManifest() {
  static const char MANIFEST[] PROGMEM =
    "{\"name\":\"EV Tracker\",\"short_name\":\"EV Tracker\",\"start_url\":\"/\","
    "\"display\":\"standalone\",\"background_color\":\"#EFE7D6\",\"theme_color\":\"#003153\","
    "\"icons\":[{\"src\":\"/icon.svg\",\"sizes\":\"any\",\"type\":\"image/svg+xml\",\"purpose\":\"any\"}]}";
  server.sendHeader("Cache-Control", "max-age=86400");
  server.send_P(200, "application/manifest+json", MANIFEST);
}

void handleIcon() {
  static const char ICON[] PROGMEM =
    "<svg xmlns='http://www.w3.org/2000/svg' viewBox='0 0 64 64'>"
    "<rect width='64' height='64' rx='12' fill='#003153'/>"
    "<circle cx='32' cy='30' r='15' fill='none' stroke='#EFE7D6' stroke-width='4'/>"
    "<path d='M32 30 L41 21' stroke='#EFE7D6' stroke-width='4' stroke-linecap='round'/>"
    "<rect x='17' y='49' width='30' height='5' rx='2.5' fill='#5E8C57'/></svg>";
  server.sendHeader("Cache-Control", "max-age=86400");
  server.send_P(200, "image/svg+xml", ICON);
}

String alertsJson() {
  String s = "[";
  for (uint8_t i = 0; i < alertCount; i++) {
    const Alert& a = alerts[i];
    if (i) s += ',';
    s += "{\"up\":" + String(a.up) + ",\"boot\":" + String(a.boot);
    s += ",\"utc\":\"" + isoUtc(a.epoch) + "\"";
    s += ",\"type\":\"" + String(ALERT_NAMES[a.type]) + "\"";
    s += ",\"v\":" + String(a.v, 2);
    if (a.hasLoc) s += ",\"lat\":" + String(a.lat, 6) + ",\"lng\":" + String(a.lng, 6);
    s += '}';
  }
  return s + "]";
}

void handleStatus() {
  String s; s.reserve(3072);
  bool fix = gpsFix();
  bool sta = WiFi.status() == WL_CONNECTED;

  s += "{\"id\":\"" VEHICLE_ID "\",\"fw\":\"" FW_VERSION "\",\"uptime\":" + String(uptimeS());
  s += ",\"boot\":" + String(bootCount);

  s += ",\"gps\":{\"fix\":"; s += fix ? "true" : "false";
  if (gps.location.isValid()) {
    s += ",\"lat\":" + String(gps.location.lat(), 6) + ",\"lng\":" + String(gps.location.lng(), 6);
  }
  s += ",\"speed\":" + String(gpsSpeed(), 1);
  s += ",\"sats\":" + String(gps.satellites.isValid() ? gps.satellites.value() : 0);
  s += ",\"hdop\":" + String(gps.hdop.isValid() ? gps.hdop.hdop() : 0.0, 1);
  s += ",\"utc\":\"" + isoUtc(utcNow()) + "\"}";

  s += ",\"engine\":{\"on\":"; s += engineOn ? "true" : "false";
  s += ",\"pps\":" + String(pulsesPerSec, 1);
  s += ",\"mode\":\""; s += ENGINE_SENSE_MODE == 0 ? "hall" : "ignition"; s += "\"}";

  s += ",\"battery\":{\"ok\":"; s += inaOk ? "true" : "false";
  s += ",\"v\":" + String(battVoltage, 2) + ",\"mA\":" + String(battCurrent_mA, 0);
  s += ",\"pct\":" + String(batteryPercent());
  s += ",\"present\":"; s += batteryPresent ? "true" : "false";
  s += ",\"alarm\":"; s += alarmActive ? "true" : "false";
  s += ",\"minV\":" + String(BATT_PRESENT_MIN_V, 1) + "}";

  s += ",\"relay\":{\"immobilised\":"; s += immobilised ? "true" : "false";
  s += ",\"pending\":"; s += (immobilisePending || restoreCutAtBoot) ? "true" : "false";
  s += ",\"maxKmph\":" + String(IMMOBILISE_MAX_KMPH, 1) + "}";

  s += ",\"net\":{\"ip\":\""; s += sta ? WiFi.localIP().toString() : String("");
  s += "\",\"ssid\":\"" + jsonEscape(sta ? WiFi.SSID() : String(WIFI_SSID)) + "\"";
  s += ",\"sta\":"; s += sta ? "true" : "false";
  s += ",\"rssi\":" + String(sta ? WiFi.RSSI() : 0);
  s += ",\"ap\":\"" AP_SSID "\",\"apIp\":\"" + WiFi.softAPIP().toString() + "\"";
  s += ",\"mdns\":\"" MDNS_NAME ".local\"}";

  s += ",\"gsm\":{\"enabled\":"; s += USE_SIM800L ? "true" : "false";
  s += ",\"ok\":"; s += modemOk ? "true" : "false";
  s += ",\"reg\":"; s += netRegistered ? "true" : "false";
  s += ",\"csq\":" + String(csq);
  s += ",\"op\":\"" + jsonEscape(gsmOperator) + "\"";
  s += ",\"sms\":"; s += (USE_SIM800L && SMS_ENABLED) ? "true" : "false";
  s += ",\"smsPending\":"; s += pendingSms ? "true" : "false"; s += "}";

  s += ",\"alerts\":" + alertsJson() + "}";
  sendJson(200, s);
}

void handleCmd() {
  String pin = server.arg("pin");
  String c   = server.arg("c");
  if (pin != CONTROL_PIN) { sendJson(403, "{\"ok\":false,\"msg\":\"Wrong PIN\"}"); return; }
  if (!c.length())        { sendJson(400, "{\"ok\":false,\"msg\":\"Missing command\"}"); return; }
  CmdResult r = applyCommand(c);
  sendJson(r.ok ? 200 : 409, String("{\"ok\":") + (r.ok ? "true" : "false") +
                             ",\"msg\":\"" + jsonEscape(r.msg) + "\"}");
}

void handleNotFound() {
  if (server.method() == HTTP_OPTIONS) { handleOptions(); return; }
  sendJson(404, "{\"ok\":false,\"msg\":\"Not found\"}");
}

void startWebServer() {
  server.on("/", HTTP_GET, handleRoot);
  server.on("/index.html", HTTP_GET, handleRoot);
  server.on("/manifest.webmanifest", HTTP_GET, handleManifest);
  server.on("/icon.svg", HTTP_GET, handleIcon);
  server.on("/api/status", HTTP_GET, handleStatus);
  server.on("/api/status", HTTP_OPTIONS, handleOptions);
  server.on("/api/cmd", HTTP_POST, handleCmd);
  server.on("/api/cmd", HTTP_OPTIONS, handleOptions);
  server.onNotFound(handleNotFound);
  server.begin();
  Serial.println(F("[OK] Web server on port 80"));
}

// =====================================================================
// SIM800L (SMS only)
// =====================================================================
#if USE_SIM800L
void modemHardReset() {
  pinMode(PIN_SIM_RST, OUTPUT);
  digitalWrite(PIN_SIM_RST, LOW);       // RST is active LOW
  delay(200);
  pinMode(PIN_SIM_RST, INPUT);          // release: never drive 3.3 V into the 2.8 V pin
  unsigned long t = millis();
  while (millis() - t < 3000) { server.handleClient(); serviceGPS(); delay(5); }
}

// Network registration is checked in maintainModem() so boot never blocks for a minute
void startModem() {
  Serial.println(F("[..] SIM800L reset + init"));
  modemHardReset();
  SerialAT.begin(SIM_BAUD, SERIAL_8N1, PIN_SIM_RX, PIN_SIM_TX);
  delay(500);

  modemOk = modem.init(strlen(SIM_PIN) ? SIM_PIN : nullptr);
  netRegistered = false;
  if (!modemOk) { Serial.println(F("[ERR] SIM800L not answering (check power 3.7-4.2 V, TX/RX, baud)")); return; }
  Serial.printf("[OK] Modem: %s\n", modem.getModemInfo().c_str());
  Serial.printf("     SIM status: %d (1 = ready)\n", (int)modem.getSimStatus());
  lastModemCheck = millis() - MODEM_CHECK_MS;   // check registration on the next loop
}

void maintainModem() {
  unsigned long gap = netRegistered ? MODEM_CHECK_MS : MODEM_REG_CHECK_MS;
  if (millis() - lastModemCheck < gap) return;
  lastModemCheck = millis();
  if (!modemOk) { startModem(); return; }

  if (!modem.testAT(2000)) {            // modem hung (often a brown-out)
    Serial.println(F("[WARN] SIM800L not responding, hard reset"));
    modemOk = false;
    startModem();
    return;
  }
  csq = modem.getSignalQuality();
  bool reg = modem.isNetworkConnected();
  if (reg && !netRegistered) {
    gsmOperator = modem.getOperator();
    Serial.printf("[OK] 2G network: %s  CSQ %d\n", gsmOperator.c_str(), csq);
  }
  if (!reg && netRegistered) Serial.println(F("[WARN] 2G network lost (coverage? antenna?)"));
  static unsigned long lastNoNetWarn = 0;
  if (!reg && !netRegistered && millis() > 90000 && millis() - lastNoNetWarn > 60000) {
    lastNoNetWarn = millis();
    Serial.println(F("[WARN] Still no 2G network (Jio SIM? antenna? 2G coverage?)"));
  }
  netRegistered = reg;
}

bool sendSms(const String& text) {
  if (!SMS_ENABLED || !modemOk) return false;
  bool ok = modem.sendSMS(OWNER_PHONE, text);
  Serial.printf("[%s] SMS to owner\n", ok ? "OK" : "ERR");
  return ok;
}

void sendPendingSms() {
  if (!(pendingSms || pendingRestoreSms) || !modemOk || !netRegistered) return;
  if (lastSmsTry && millis() - lastSmsTry < SMS_RETRY_MS) return;   // don't hammer a failing modem

  if (pendingSms && (lastSmsMs == 0 || millis() - lastSmsMs > SMS_MIN_GAP_MS)) {
    lastSmsTry = millis();
    String msg = "EV TRACKER ALERT: battery removed! V=" + String(battVoltage, 1) + "V. " + mapsLink();
    if (sendSms(msg)) { pendingSms = false; lastSmsMs = millis(); lastSmsTry = 0; }
    return;
  }
  if (pendingRestoreSms && !pendingSms) {
    lastSmsTry = millis();
    if (sendSms("EV TRACKER: battery reconnected. " + mapsLink())) { pendingRestoreSms = false; lastSmsTry = 0; }
  }
}
#else
bool sendSms(const String&) { return false; }
#endif

// =====================================================================
// ENGINE
// =====================================================================
void updateEngine() {
#if ENGINE_SENSE_MODE == 0
  unsigned long last;
  noInterrupts(); last = lastPulseMs; interrupts();
  engineOn = (last != 0) && (millis() - last < ENGINE_TIMEOUT_MS);
  if (millis() - lastRateCalc >= 1000) {
    uint32_t c; noInterrupts(); c = hallPulseCount; interrupts();
    pulsesPerSec = (c - lastPulseSnapshot) * 1000.0 / (millis() - lastRateCalc);
    lastPulseSnapshot = c; lastRateCalc = millis();
  }
#else
  engineOn = (digitalRead(PIN_ENGINE) == LOW);
#endif
}

// =====================================================================
// BATTERY
// =====================================================================
void updateBattery() {
  if (!inaOk) return;
  battVoltage    = ina.getBusVoltage() * BATT_DIVIDER_RATIO;
  battCurrent_mA = ina.getCurrent_mA();

  if (battVoltage < BATT_PRESENT_MIN_V) { if (battLowCount < 255) battLowCount++; battOkCount = 0; }
  else                                  { if (battOkCount < 255)  battOkCount++;  battLowCount = 0; }

  if (batteryPresent && battLowCount >= BATT_DEBOUNCE_COUNT) {
    batteryPresent = false; alarmActive = true;
    pendingSms = USE_SIM800L && SMS_ENABLED;
    setBuzzer(true);
    logAlert(A_BATTERY_REMOVED);
    Serial.println(F("!!! ALERT: BATTERY REMOVED !!!"));
  }
  if (!batteryPresent && battOkCount >= BATT_DEBOUNCE_COUNT) {
    batteryPresent = true;
    pendingRestoreSms = USE_SIM800L && SMS_ENABLED;
    logAlert(A_BATTERY_RESTORED);
    Serial.println(F("Battery restored (alarm stays on until Silence alarm / 'c')"));
  }
}

// =====================================================================
// SERIAL TEST MENU
// =====================================================================
void printHelp() {
  Serial.println(F("\n--- Test menu (Serial Monitor 115200, line ending: Newline) ---"));
  Serial.println(F(" h help            s status + URL    i I2C scan"));
  Serial.println(F(" r toggle relay    b buzzer beep     c clear alarm"));
  Serial.println(F(" g raw GPS 5 s     m modem info      t send test SMS"));
  Serial.println(F(" p AT pass-through to SIM800L (type ~ to exit)"));
}

void printStatus() {
  Serial.printf("GPS fix:%s sats:%u lat:%.6f lng:%.6f spd:%.1f | ",
    gpsFix() ? "Y" : "N", (unsigned)gps.satellites.value(),
    gps.location.lat(), gps.location.lng(), gpsSpeed());
#if ENGINE_SENSE_MODE == 0
  Serial.printf("ENG:%s (%.1f p/s) | ", engineOn ? "ON" : "OFF", pulsesPerSec);
#else
  Serial.printf("ENG:%s | ", engineOn ? "ON" : "OFF");
#endif
  Serial.printf("BATT:%.2fV %.0fmA %d%% %s | RELAY:%s | CSQ:%d | WiFi:%s\n",
    battVoltage, battCurrent_mA, batteryPercent(), batteryPresent ? "OK" : "REMOVED",
    immobilised ? "IMMOBILISED" : (immobilisePending ? "CUT QUEUED" : "RUN"), csq,
    WiFi.status() == WL_CONNECTED ? WiFi.localIP().toString().c_str() : "no");
}

void modemInfo() {
#if USE_SIM800L
  if (!modemOk) { Serial.println(F("Modem not initialised")); return; }
  Serial.printf("Modem   : %s\n", modem.getModemInfo().c_str());
  Serial.printf("SIM     : %d (1 = ready)\n", (int)modem.getSimStatus());
  Serial.printf("Operator: %s\n", modem.getOperator().c_str());
  Serial.printf("CSQ     : %d (10-31 good, 99 = none)\n", modem.getSignalQuality());
  Serial.printf("Network : %s\n", modem.isNetworkConnected() ? "registered" : "NOT registered");
#else
  Serial.println(F("SIM800L disabled (USE_SIM800L false)"));
#endif
}

void atPassThrough() {
#if USE_SIM800L
  Serial.println(F("AT pass-through. Type AT commands, ~ to exit."));
  while (true) {
    while (SerialAT.available()) Serial.write(SerialAT.read());
    if (Serial.available()) {
      char ch = Serial.read();
      if (ch == '~') break;
      SerialAT.write(ch);
    }
    serviceGPS();
    server.handleClient();
  }
  Serial.println(F("Pass-through closed."));
#else
  Serial.println(F("SIM800L disabled (USE_SIM800L false)"));
#endif
}

void handleSerialMenu() {
  if (!Serial.available()) return;
  char c = Serial.read();
  switch (c) {
    case 'h': printHelp(); break;
    case 's': printStatus(); printUrls(); break;
    case 'r':                                   // bench test: direct toggle, no speed guard
      immobilisePending = false; restoreCutAtBoot = false;
      setRelay(!immobilised); saveRelayState();
      logAlert(immobilised ? A_IGNITION_CUT : A_IGNITION_ALLOWED);
      Serial.printf("Relay -> %s\n", immobilised ? "IMMOBILISED (energised)" : "RUN (released)"); break;
    case 'b': applyCommand("BEEP"); break;
    case 'c': applyCommand("CLEAR"); Serial.println(F("Alarm cleared")); break;
    case 'm': modemInfo(); break;
    case 't': Serial.println(applyCommand("SMS").msg); break;
    case 'p': atPassThrough(); break;
    case 'g': {
      unsigned long t = millis();
      while (millis() - t < 5000) {
        if (GPSSerial.available()) Serial.write(GPSSerial.read());
        server.handleClient();
      }
      Serial.println(); break;
    }
    case 'i':
      Serial.println(F("I2C scan:"));
      for (uint8_t a = 1; a < 127; a++) {
        Wire.beginTransmission(a);
        if (Wire.endTransmission() == 0) Serial.printf("  found 0x%02X\n", a);
      }
      break;
    default: break;
  }
}
